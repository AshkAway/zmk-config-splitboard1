## config/boards/shields/splitboard1/Kconfig.defconfig
```kconfig
# Copyright (c) 2020 The ZMK Contributors
# SPDX-License-Identifier: MIT

if SHIELD_splitboard1_LEFT

config ZMK_KEYBOARD_NAME
    default "splitboard1"

config ZMK_SPLIT_ROLE_CENTRAL
    default y

endif

if SHIELD_splitboard1_LEFT || SHIELD_splitboard1_RIGHT

config ZMK_SPLIT
    default y

endif
```

## config/boards/shields/splitboard1/Kconfig.shield
```kconfig
# Copyright (c) 2020 The ZMK Contributors
# SPDX-License-Identifier: MIT

config SHIELD_splitboard1_LEFT
    def_bool $(shields_list_contains,splitboard1_left)

config SHIELD_splitboard1_RIGHT
    def_bool $(shields_list_contains,splitboard1_right)
```
